## arch/arm/configs/tizen_b3_cdma_vzw_defconfig
```kconfig
CONFIG_MACH_B3_CDMA_VZW=y

#MODEM SECURE CHECK
CONFIG_SEC_PERIPHERAL_SECURE_CHK=y
```

## arch/arm/configs/tizen_wc1_cdma_vzw_defconfig
```kconfig
CONFIG_MACH_WC1_CDMA_VZW=y

#MODEM SECURE CHECK
CONFIG_SEC_PERIPHERAL_SECURE_CHK=y
```

## drivers/sensorhub/atmel/factory/Kconfig
```kconfig
#
# sensor drivers configuration
#
config SENSORS_SSP_BMI168
	tristate "Sensors ssp bmi168"
	default n
	depends on SPI
	help
	  bmi160 file for factory test in ssp driver.
          If you say yes here you get bmi168 support for
	  factory test.
	  To compile this driver as a module, choose M here: the
	  module will be called ssp.

config SENSORS_SSP_K6DS3TR
	tristate "Sensors ssp k6ds3tr"
	default n
	depends on SPI
	help
	  k6ds3tr file for factory test in ssp driver.
          If you say yes here you get k6ds3tr support for
	  factory test.
	  To compile this driver as a module, choose M here: the
	  module will be called ssp.

config SENSORS_SSP_YAS537
	tristate "Sensors ssp yas537"
	default n
	depends on SPI
	help
	  yas537 file for factory test in ssp driver.
          If you say yes here you get yas537 support for
	  factory test.
	  To compile this driver as a module, choose M here: the
	  module will be called ssp.

config SENSORS_SSP_LPS25H
	tristate "Sensors ssp lps25h"
	default n
	depends on SPI
	help
	  lps25h file for factory test in ssp driver.
          If you say yes here you get lps25h support for
	  factory test.
	  To compile this driver as a module, choose M here: the
	  module will be called ssp.

config SENSORS_SSP_TSL2584
	tristate "Sensors ssp tsl2584"
	default n
	depends on SPI
	help
	  tsl2584 file for factory test in ssp driver.
          If you say yes here you get tsl2584 support for
	  factory test.
	  To compile this driver as a module, choose M here: the
	  module will be called ssp.

config SENSORS_SSP_AD45251
	tristate "Sensors ssp ad45251"
	default n
	depends on SPI
	help
	  adpd45251 file for factory test in ssp driver.
          If you say yes here you get ad45251 support for
	  factory test.
	  To compile this driver as a module, choose M here: the
	  module will be called ssp.

config SENSORS_SSP_PPS960
	tristate "Sensors ssp pps960"
	default n
	depends on SPI
	help
	  pps960 file for factory test in ssp driver.
          If you say yes here you get pps960 support for
	  factory test.
	  To compile this driver as a module, choose M here: the
	  module will be called ssp.

config SENSORS_SSP_ATSAMG55
	tristate "Sensors ssp atsamg55"
	default n
	depends on SPI
	help
	  atsamg55 file for factory test in ssp driver.
          If you say yes here you get atsamg55 support for
	  factory test.
	  To compile this driver as a module, choose M here: the
	  module will be called ssp.
```

## sound/soc/codecs/dbmd2/Kconfig
```kconfig
#
# SoC audio configuration
#

config SND_SOC_DBMD2P3
        bool "DSPG Voice Trigger/Enhancement Chip common driver v3"
        default n

config SND_SOC_DBMD2P3_UART
        bool "DSPG Voice Trigger/Enhancement Chip uart driver v3"
        depends on SND_SOC_DBMD2P3
        default n
        help
          DBMD2P3 kernel driver for kernel v3.4

config SND_SOC_DBMD2P3_SPI
        bool "DSPG Voice Trigger/Enhancement Chip spi driver v3"
        depends on SND_SOC_DBMD2P3
        default n
        help
          DBMD2P3 kernel driver for kernel v3.4

config SND_SOC_DBMD2P3_I2C
        bool "DSPG Voice Trigger/Enhancement Chip i2c driver v3"
        depends on SND_SOC_DBMD2P3
        default n
        help
          DBMD2P3 kernel driver for kernel v3.4

config SND_SOC_DBMD2P3_V34_PORT
        bool "DSPG Voice Trigger/Enhancement Chip driver v3"
        depends on SND_SOC_DBMD2P3
        default n
        help
          DBMD2P3 kernel driver for kernel v3.4
```

## sound/soc/dvf/Kconfig
```kconfig
config SND_DVF_DBMD2_PCM
	bool "DSPG DBMD2 Capture Device"
	default n
	depends on SND_SOC_DBMD2
	help
	  This is Sound Card emulation for DSPG DBMD2 Voice Trigger. Select if you
	  want to capture from DBMD2 and/or to control it via mixer controls
```
